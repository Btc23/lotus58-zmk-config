## config/west.yml
```yaml
manifest:
  remotes:
    - name: zmkfirmware
      url-base: https://github.com/Btc23
  projects:
    - name: zmk
      remote: zmkfirmware
      revision: add-support-right-encoder
      import: app/west.yml
  self:
    path: config
```
